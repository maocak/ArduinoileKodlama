// --- PIN TANIMLARI ---
const int DIN_PIN = 12; // MAX7219 DIN
const int CS_PIN  = 11; // MAX7219 CS (LOAD)
const int CLK_PIN = 10; // MAX7219 CLK

// --- MAX7219 REGISTER ADRESLERİ ---
#define REG_DECODE_MODE  0x09
#define REG_INTENSITY    0x0A
#define REG_SCAN_LIMIT   0x0B
#define REG_SHUTDOWN     0x0C
#define REG_DISPLAY_TEST 0x0F

// --- FONT TABLOSU (5 Sütun x 8 Satır) ---
// A'dan Z'ye (26 Harf) + 0'dan 9'a (10 Rakam) = Toplam 36 Karakter
const byte FONT[][5] = {
  // A - Z
  {0x7E, 0x11, 0x11, 0x11, 0x7E}, // A (0)
  {0x7F, 0x49, 0x49, 0x49, 0x36}, // B (1)
  {0x3E, 0x41, 0x41, 0x41, 0x22}, // C (2)
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  {0x61, 0x51, 0x49, 0x45, 0x43}, // Z (25)

  // 0 - 9
  {0x3E, 0x51, 0x49, 0x45, 0x3E}, // 0 (26)
  {0x00, 0x42, 0x7F, 0x40, 0x00}, // 1 (27)
  {0x42, 0x61, 0x51, 0x49, 0x46}, // 2 (28)
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  {0x06, 0x49, 0x49, 0x29, 0x1E}  // 9 (35)
};

const int TOPLAM_KARAKTER = sizeof(FONT) / sizeof(FONT[0]);

// MAX7219'a veri gönderen temel SPI fonksiyonu
void sendData(byte reg, byte data) {
  digitalWrite(CS_PIN, LOW);
  shiftOut(DIN_PIN, CLK_PIN, MSBFIRST, reg);
  shiftOut(DIN_PIN, CLK_PIN, MSBFIRST, data);
  digitalWrite(CS_PIN, HIGH);
}

// Tüm ekranı temizler
void clearDisplay() {
  for (byte i = 1; i <= 8; i++) {
    sendData(i, 0x00);
  }
}

// 5 sütunluk karakteri 8x8 matrisin ortasına (2-6. sütunlar arasına) çizer
void drawCharacter(const byte sprite[5]) {
  clearDisplay();
  for (byte col = 0; col < 5; col++) {
    sendData(col + 2, sprite[col]);
  }
}

void setup() {
  pinMode(DIN_PIN, OUTPUT);
  pinMode(CS_PIN, OUTPUT);
  pinMode(CLK_PIN, OUTPUT);

  // MAX7219 Başlatma Ayarları
  sendData(REG_DISPLAY_TEST, 0x00); // Test modunu kapat
  sendData(REG_DECODE_MODE, 0x00);  // Ham matris modu (kod çözücü kapalı)
  sendData(REG_SCAN_LIMIT, 0x07);   // 8 sütunun tamamını tara (0-7)
  sendData(REG_INTENSITY, 0x08);    // Parlaklık (0-15 arası)
  sendData(REG_SHUTDOWN, 0x01);     // Normal çalışma moduna al

  clearDisplay();
}

void loop() {
  // Tüm harfleri (A-Z) ve rakamları (0-9) sırayla ekrana basar
  for (int i = 0; i < TOPLAM_KARAKTER; i++) {
    drawCharacter(FONT[i]);
    delay(1000); // 1 saniye bekle
  }
}
